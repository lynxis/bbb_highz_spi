/dts-v1/;
/plugin/;

/ {
    compatible = "ti,beaglebone", "ti,beaglebone-black", "ti,beaglebone-green";
    part-number = "LYNXIS-SPI0";
    version =  "00A0";
    exclusive-use = "spi0";

    fragment@0 {
        target  = <&spi0>;
        __overlay__ {
            status = "okay";
            #address-cells = <1>;
            #size-cells = <0>;
            ti,pio-mode;
            spidev@0 {
                #address-cells = <1>;
                #size-cells = <0>;
                spi-max-frequency = <16000000>;
                reg = <0>;
                compatible = "linux,spidev";
            };
        };
    };
};

